## main/Kconfig.projbuild
```kconfig
menu "MorningLight Configuration"

    menu "GPIO Configuration"
        config ML_GPIO_LED_R
            int "Red LED GPIO"
            default 27
            help
                GPIO pin for PWM red channel.

        config ML_GPIO_LED_G
            int "Green LED GPIO"
            default 26
            help
                GPIO pin for PWM green channel.

        config ML_GPIO_LED_B
            int "Blue LED GPIO"
            default 25
            help
                GPIO pin for PWM blue channel.

        config ML_GPIO_WS1_DATA
            int "Addressable Strip 1 Data GPIO"
            default 33
            help
                GPIO pin for addressable LED strip 1 data (WS2812 etc).

        config ML_GPIO_WS1_ENABLE
            int "Addressable Strip 1 Enable GPIO"
            default 32
            help
                GPIO pin driving the low-side N-channel MOSFET that gates
                strip 1's ground return (power-gate on/off).

        config ML_GPIO_WS2_DATA
            int "Addressable Strip 2 Data GPIO"
            default 19
            help
                GPIO pin for addressable LED strip 2 data (WS2812 etc).

        config ML_GPIO_WS2_ENABLE
            int "Addressable Strip 2 Enable GPIO"
            default 18
            help
                GPIO pin driving the low-side N-channel MOSFET that gates
                strip 2's ground return (power-gate on/off).

        config ML_GPIO_BTN_RESET
            int "Reset Button GPIO"
            default 0
            help
                GPIO pin for reset button (boot button).

        config ML_GPIO_BTN_SCENARIO
            int "Scenario Button GPIO"
            default 4
            help
                GPIO pin for scenario cycling button.

        config ML_GPIO_STATUS_LED
            int "Status LED GPIO"
            default 2
            help
                GPIO pin for built-in status LED.
    endmenu

    menu "WiFi Configuration"
        config ML_WIFI_AP_SSID_PREFIX
            string "AP SSID Prefix"
            default "MorningLight"
            help
                Prefix for the AP SSID. Device MAC suffix will be appended.

        config ML_WIFI_AP_CHANNEL
            int "AP WiFi Channel"
            default 1
            range 1 13
            help
                WiFi channel for AP mode.

        config ML_WIFI_AP_MAX_CONN
            int "AP Max Connections"
            default 4
            range 1 10
            help
                Maximum number of stations connected to AP.

        config ML_WIFI_STA_RETRY_COUNT
            int "STA Retry Count"
            default 5
            range 1 20
            help
                Number of times to retry connecting to WiFi in STA mode.

        config ML_WIFI_FALLBACK_TIMEOUT_S
            int "STA to AP Fallback Timeout (seconds)"
            default 30
            range 10 120
            help
                Seconds to wait before falling back to AP mode if STA fails.
    endmenu

    menu "LED Configuration"
        config ML_LED_WS1_ENABLED_DEFAULT
            bool "Addressable Strip 1 Populated by Default"
            default y
            help
                Whether addressable strip 1 is enabled out of the box.

        config ML_LED_WS2_ENABLED_DEFAULT
            bool "Addressable Strip 2 Populated by Default"
            default n
            help
                Whether addressable strip 2 is enabled out of the box.

        config ML_LED_PWM_ENABLED_DEFAULT
            bool "PWM RGB Connector Populated by Default"
            default n
            help
                Whether the discrete PWM RGB strip connector is enabled out
                of the box. All three outputs may be enabled simultaneously.

        config ML_LED_COUNT_DEFAULT
            int "Default LED Count"
            default 30
            range 1 300
            help
                Default number of LEDs for WS2811 strips.

        config ML_LED_DITHER_ENABLED_DEFAULT
            bool "Temporal Dithering Enabled by Default"
            default n
            help
                Whether temporal error-diffusion dithering on the animated
                WS2811 pixel path is enabled out of the box. Can smooth out
                8-bit quantization stepping at low brightness/color
                temperature, but subtly alters wave animation timing.
                User-toggleable at runtime via the Settings page.

        config ML_LED_DITHER_FREQ_HZ_DEFAULT
            int "Temporal Dithering Update Frequency (Hz)"
            default 10
            range 1 60
            help
                How often the dithering error-diffusion step updates, in Hz.
                Lower values reduce how often output can toggle between
                adjacent 8-bit levels (less shimmer, coarser temporal
                resolution); higher values approach the animation frame
                rate (~30 Hz) for the smoothest time-averaged brightness.
                Only takes effect when dithering is enabled.

        config ML_LED_DITHER_MAX_BRIGHTNESS_PCT_DEFAULT
            int "Temporal Dithering Brightness Ceiling (%)"
            default 50
            range 0 100
            help
                Dithering only applies to LEDs whose current animated
                brightness is at or below this percentage; above it, output
                is plain-rounded with no dithering. Keeps dithering confined
                to the low end where 8-bit quantization stepping is
                actually visible.

        config ML_LED_PWM_FREQ_HZ
            int "PWM Frequency (Hz)"
            default 4000
            range 1000 20000
            help
                PWM frequency for LED control.

        config ML_LED_GAMMA
            string "Gamma Correction Value"
            default "2.2"
            help
                Gamma value for perceptually uniform brightness.

        config ML_LED_MAX_BRIGHTNESS
            int "Maximum Brightness (%)"
            default 100
            range 10 100
            help
                Maximum LED brightness percentage.
    endmenu

    menu "NTP Configuration"
        config ML_NTP_SERVER1
            string "Primary NTP Server"
            default "pool.ntp.org"
            help
                Primary NTP server for time sync.

        config ML_NTP_SERVER2
            string "Secondary NTP Server"
            default "time.google.com"
            help
                Secondary NTP server for time sync.

        config ML_NTP_SYNC_INTERVAL_H
            int "NTP Sync Interval (hours)"
            default 6
            range 1 24
            help
                Hours between NTP sync attempts.

        config ML_DEFAULT_TIMEZONE
            string "Default Timezone"
            default "UTC0"
            help
                Default POSIX timezone string.
    endmenu

    menu "Sunrise Configuration"
        config ML_SUNRISE_DEFAULT_DURATION_MIN
            int "Default Sunrise Duration (minutes)"
            default 30
            range 5 120
            help
                Default duration for sunrise simulation.

        config ML_SUNRISE_UPDATE_INTERVAL_MS
            int "Sunrise Update Interval (ms)"
            default 100
            range 50 1000
            help
                Milliseconds between brightness updates during sunrise.
    endmenu

    menu "Animation Configuration"
        config ML_ANIM_UPDATE_INTERVAL_MS
            int "Animation Update Interval (ms)"
            default 33
            range 16 100
            help
                Milliseconds between animation frame updates.
                33ms = ~30fps, 16ms = ~60fps.

        config ML_ANIM_TASK_STACK_SIZE
            int "Animation Task Stack Size"
            default 4096
            help
                Stack size for the animation FreeRTOS task.
    endmenu

    menu "Temperature Sensors"
        config ML_GPIO_NTC_ADC
            int "NTC Thermistor ADC GPIO"
            default 36
            help
                GPIO pin for NTC thermistor (must be ADC1 channel).

        config ML_GPIO_DS18B20_1
            int "DS18B20 Sensor 1 GPIO"
            default 15
            help
                GPIO pin for first DS18B20 temperature sensor (1-Wire).

        config ML_GPIO_DS18B20_2
            int "DS18B20 Sensor 2 GPIO"
            default 16
            help
                GPIO pin for second DS18B20 temperature sensor (1-Wire).

        config ML_NTC_BETA
            int "NTC Beta Coefficient"
            default 3950

        config ML_NTC_R_NOMINAL
            int "NTC Nominal Resistance (ohms)"
            default 10000

        config ML_NTC_R_PULLUP
            int "NTC Pull-up Resistance (ohms)"
            default 10000

        config ML_TEMP_UPDATE_INTERVAL_MS
            int "Temperature Update Interval (ms)"
            default 5000
            range 1000 30000
    endmenu

    menu "Power Monitoring"
        config ML_GPIO_CT_AC_ADC
            int "AC Current Transformer ADC GPIO"
            default 35
            help
                GPIO pin for the AC current transformer sensor (must be
                ADC1 channel).

        config ML_GPIO_DC_CURRENT_ADC
            int "DC Current Sense (Op-Amp) ADC GPIO"
            default 34
            help
                GPIO pin for the op-amp output of the DC shunt current
                sense circuit (must be ADC1 channel).

        config ML_GPIO_DC_VOLTAGE_ADC
            int "DC Voltage Sense (Divider) ADC GPIO"
            default 39
            help
                GPIO pin for the resistive-divider DC voltage sense
                (must be ADC1 channel).

        config ML_AC_CURRENT_CAL_X100
            int "AC CT Calibration Constant x100 (Amps RMS per Volt RMS)"
            default 3000
            help
                Amps-RMS per Volt-RMS measured at the ADC pin, times 100.
                Depends on CT turns ratio and burden resistor; must be
                calibrated against a known load. Default is a placeholder.

        config ML_DC_CURRENT_SCALE_X100
            int "DC Current Scale x100 (Amps per Volt)"
            default 1000
            help
                Amps per Volt of op-amp output above the zero-current
                offset, times 100. Depends on shunt resistance and op-amp
                gain; must be calibrated.

        config ML_DC_CURRENT_OFFSET_MV
            int "DC Current Zero-Offset (mV)"
            default 1650
            help
                Op-amp output voltage, in millivolts, at zero current.

        config ML_DC_VOLTAGE_SCALE_X100
            int "DC Voltage Divider Scale x100 (Volts-in per Volt-at-ADC)"
            default 933
            help
                Inverse of the voltage divider ratio, times 100.
                Default assumes a 20k/2.4k divider: (20000+2400)/2400 = 9.33.

        config ML_POWER_UPDATE_INTERVAL_MS
            int "Power Monitor Update Interval (ms)"
            default 2000
            range 500 30000

        config ML_AC_SAMPLE_WINDOW_MS
            int "AC RMS Sample Window (ms)"
            default 200
            range 100 1000
    endmenu

endmenu
```
